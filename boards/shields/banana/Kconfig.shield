## boards/shields/banana/Kconfig.shield
```kconfig
# No whitespace after the comma or in your part name!
config SHIELD_BANANA_LEFT
    def_bool $(shields_list_contains,banana_left)

# No whitespace after the comma or in your part name!
config SHIELD_BANANA_RIGHT
    def_bool $(shields_list_contains,banana_right)
```

## config/west.yml
```yaml
manifest:
  remotes:
    - name: zmkfirmware
      url-base: https://github.com/zmkfirmware
    - name: banana
      url-base: https://github.com/maximoh-mmo/keyboard
    # Additional modules containing boards/shields/custom code can be listed here as well
    # See https://docs.zephyrproject.org/3.2.0/develop/west/manifest.html#projects
  projects:
    - name: zmk
      remote: zmkfirmware
      revision: main
      import: app/west.yml
    - name: banana
      remote: banana
      revision: main
  self:
    path: config
```
